## CoAP_serverwithUARTRXFinal/build/Kconfig/arch/Kconfig
```kconfig
# Load Zephyr Arch Kconfig descriptions.
osource "/home/rosy-jwang/zephyrproject/zephyr/arch/rx/Kconfig"
osource "/home/rosy-jwang/zephyrproject/zephyr/arch/x86/Kconfig"
osource "/home/rosy-jwang/zephyrproject/zephyr/arch/xtensa/Kconfig"
osource "/home/rosy-jwang/zephyrproject/zephyr/arch/sparc/Kconfig"
osource "/home/rosy-jwang/zephyrproject/zephyr/arch/riscv/Kconfig"
osource "/home/rosy-jwang/zephyrproject/zephyr/arch/posix/Kconfig"
osource "/home/rosy-jwang/zephyrproject/zephyr/arch/mips/Kconfig"
osource "/home/rosy-jwang/zephyrproject/zephyr/arch/arm64/Kconfig"
osource "/home/rosy-jwang/zephyrproject/zephyr/arch/arm/Kconfig"
osource "/home/rosy-jwang/zephyrproject/zephyr/arch/arc/Kconfig"
```

## CoAP_serverwithUARTRXFinal/build/Kconfig/boards/Kconfig
```kconfig
# Load Zephyr board Kconfig descriptions.
osource "/home/rosy-jwang/zephyrproject/zephyr/boards/nordic/nrf52840dk/Kconfig"
```

## CoAP_serverwithUARTRXFinal/build/Kconfig/boards/Kconfig.defconfig
```kconfig
# Load Zephyr board defconfig descriptions.
osource "/home/rosy-jwang/zephyrproject/zephyr/boards/nordic/nrf52840dk/Kconfig.defconfig"
```

## CoAP_serverwithUARTRXFinal/build/Kconfig/boards/Kconfig.nrf52840dk
```kconfig
# Load board Kconfig descriptions.
osource "/home/rosy-jwang/zephyrproject/zephyr/boards/nordic/nrf52840dk/Kconfig.nrf52840dk"
```

## CoAP_serverwithUARTRXFinal/build/Kconfig/boards/Kconfig.sysbuild
```kconfig
# Load Sysbuild board Kconfig descriptions.
osource "/home/rosy-jwang/zephyrproject/zephyr/boards/nordic/nrf52840dk/Kconfig.sysbuild"
```

## CoAP_serverwithUARTRXFinal/build/Kconfig/soc/Kconfig
```kconfig
# Load Zephyr SoC Kconfig descriptions.
osource "/home/rosy-jwang/zephyrproject/zephyr/soc/xlnx/zynqmp/Kconfig"
osource "/home/rosy-jwang/zephyrproject/zephyr/soc/xlnx/zynq7000/Kconfig"
osource "/home/rosy-jwang/zephyrproject/zephyr/soc/xlnx/versalnet/Kconfig"
osource "/home/rosy-jwang/zephyrproject/zephyr/soc/xlnx/versal2/Kconfig"
osource "/home/rosy-jwang/zephyrproject/zephyr/soc/xen/Kconfig"
osource "/home/rosy-jwang/zephyrproject/zephyr/soc/wch/ch32v/Kconfig"
osource "/home/rosy-jwang/zephyrproject/zephyr/soc/ti/simplelink/Kconfig"
osource "/home/rosy-jwang/zephyrproject/zephyr/soc/ti/mspm0/Kconfig"
osource "/home/rosy-jwang/zephyrproject/zephyr/soc/ti/lm3s6965/Kconfig"
osource "/home/rosy-jwang/zephyrproject/zephyr/soc/ti/k3/Kconfig"
osource "/home/rosy-jwang/zephyrproject/zephyr/soc/telink/tlsr/Kconfig"
osource "/home/rosy-jwang/zephyrproject/zephyr/soc/starfive/jh71xx/Kconfig"
osource "/home/rosy-jwang/zephyrproject/zephyr/soc/st/stm32/Kconfig"
osource "/home/rosy-jwang/zephyrproject/zephyr/soc/snps/qemu_arc/Kconfig"
osource "/home/rosy-jwang/zephyrproject/zephyr/soc/snps/nsim/arc_v/Kconfig"
osource "/home/rosy-jwang/zephyrproject/zephyr/soc/snps/nsim/arc_classic/Kconfig"
osource "/home/rosy-jwang/zephyrproject/zephyr/soc/snps/hsdk4xd/Kconfig"
osource "/home/rosy-jwang/zephyrproject/zephyr/soc/snps/hsdk/Kconfig"
osource "/home/rosy-jwang/zephyrproject/zephyr/soc/snps/emsk/Kconfig"
osource "/home/rosy-jwang/zephyrproject/zephyr/soc/snps/emsdp/Kconfig"
osource "/home/rosy-jwang/zephyrproject/zephyr/soc/snps/arc_iot/Kconfig"
osource "/home/rosy-jwang/zephyrproject/zephyr/soc/silabs/Kconfig"
osource "/home/rosy-jwang/zephyrproject/zephyr/soc/sifive/sifive_freedom/Kconfig"
osource "/home/rosy-jwang/zephyrproject/zephyr/soc/sensry/Kconfig"
osource "/home/rosy-jwang/zephyrproject/zephyr/soc/rockchip/Kconfig"
osource "/home/rosy-jwang/zephyrproject/zephyr/soc/renode/riscv_virtual/Kconfig"
osource "/home/rosy-jwang/zephyrproject/zephyr/soc/renode/cortex_r8_virtual/Kconfig"
osource "/home/rosy-jwang/zephyrproject/zephyr/soc/renesas/smartbond/Kconfig"
osource "/home/rosy-jwang/zephyrproject/zephyr/soc/renesas/rz/Kconfig"
osource "/home/rosy-jwang/zephyrproject/zephyr/soc/renesas/rx/Kconfig"
osource "/home/rosy-jwang/zephyrproject/zephyr/soc/renesas/rcar/Kconfig"
osource "/home/rosy-jwang/zephyrproject/zephyr/soc/renesas/ra/Kconfig"
osource "/home/rosy-jwang/zephyrproject/zephyr/soc/realtek/ec/Kconfig"
osource "/home/rosy-jwang/zephyrproject/zephyr/soc/raspberrypi/rpi_pico/Kconfig"
osource "/home/rosy-jwang/zephyrproject/zephyr/soc/quicklogic/eos_s3/Kconfig"
osource "/home/rosy-jwang/zephyrproject/zephyr/soc/qemu/virt_riscv/Kconfig"
osource "/home/rosy-jwang/zephyrproject/zephyr/soc/qemu/malta/Kconfig"
osource "/home/rosy-jwang/zephyrproject/zephyr/soc/openisa/rv32m1/Kconfig"
osource "/home/rosy-jwang/zephyrproject/zephyr/soc/openhwgroup/cva6/Kconfig"
osource "/home/rosy-jwang/zephyrproject/zephyr/soc/oct/osd32mp15x/Kconfig"
osource "/home/rosy-jwang/zephyrproject/zephyr/soc/nxp/s32/Kconfig"
osource "/home/rosy-jwang/zephyrproject/zephyr/soc/nxp/rw/Kconfig"
osource "/home/rosy-jwang/zephyrproject/zephyr/soc/nxp/mcx/Kconfig"
osource "/home/rosy-jwang/zephyrproject/zephyr/soc/nxp/lpc/Kconfig"
osource "/home/rosy-jwang/zephyrproject/zephyr/soc/nxp/layerscape/Kconfig"
osource "/home/rosy-jwang/zephyrproject/zephyr/soc/nxp/kinetis/Kconfig"
osource "/home/rosy-jwang/zephyrproject/zephyr/soc/nxp/imxrt/Kconfig"
osource "/home/rosy-jwang/zephyrproject/zephyr/soc/nxp/imx/Kconfig"
osource "/home/rosy-jwang/zephyrproject/zephyr/soc/nuvoton/numicro/Kconfig"
osource "/home/rosy-jwang/zephyrproject/zephyr/soc/nuvoton/numaker/Kconfig"
osource "/home/rosy-jwang/zephyrproject/zephyr/soc/nuvoton/npcx/Kconfig"
osource "/home/rosy-jwang/zephyrproject/zephyr/soc/nuvoton/npcm/Kconfig"
osource "/home/rosy-jwang/zephyrproject/zephyr/soc/nordic/Kconfig"
osource "/home/rosy-jwang/zephyrproject/zephyr/soc/neorv32/Kconfig"
osource "/home/rosy-jwang/zephyrproject/zephyr/soc/native/inf_clock/Kconfig"
osource "/home/rosy-jwang/zephyrproject/zephyr/soc/microchip/sam/Kconfig"
osource "/home/rosy-jwang/zephyrproject/zephyr/soc/microchip/sam/sam_d5x_e5x/Kconfig"
osource "/home/rosy-jwang/zephyrproject/zephyr/soc/microchip/miv/Kconfig"
osource "/home/rosy-jwang/zephyrproject/zephyr/soc/microchip/mec/Kconfig"
osource "/home/rosy-jwang/zephyrproject/zephyr/soc/mediatek/mt8xxx/Kconfig"
osource "/home/rosy-jwang/zephyrproject/zephyr/soc/lowrisc/opentitan/Kconfig"
osource "/home/rosy-jwang/zephyrproject/zephyr/soc/litex/litex_vexriscv/Kconfig"
osource "/home/rosy-jwang/zephyrproject/zephyr/soc/ite/ec/Kconfig"
osource "/home/rosy-jwang/zephyrproject/zephyr/soc/intel/raptor_lake/Kconfig"
osource "/home/rosy-jwang/zephyrproject/zephyr/soc/intel/panther_lake/Kconfig"
osource "/home/rosy-jwang/zephyrproject/zephyr/soc/intel/lakemont/Kconfig"
osource "/home/rosy-jwang/zephyrproject/zephyr/soc/intel/intel_socfpga_std/Kconfig"
osource "/home/rosy-jwang/zephyrproject/zephyr/soc/intel/intel_socfpga/Kconfig"
osource "/home/rosy-jwang/zephyrproject/zephyr/soc/intel/intel_niosv/Kconfig"
osource "/home/rosy-jwang/zephyrproject/zephyr/soc/intel/intel_ish/Kconfig"
osource "/home/rosy-jwang/zephyrproject/zephyr/soc/intel/intel_adsp/Kconfig"
osource "/home/rosy-jwang/zephyrproject/zephyr/soc/intel/elkhart_lake/Kconfig"
osource "/home/rosy-jwang/zephyrproject/zephyr/soc/intel/atom/Kconfig"
osource "/home/rosy-jwang/zephyrproject/zephyr/soc/intel/apollo_lake/Kconfig"
osource "/home/rosy-jwang/zephyrproject/zephyr/soc/intel/alder_lake/Kconfig"
osource "/home/rosy-jwang/zephyrproject/zephyr/soc/infineon/cat3/Kconfig"
osource "/home/rosy-jwang/zephyrproject/zephyr/soc/infineon/cat1c/Kconfig"
osource "/home/rosy-jwang/zephyrproject/zephyr/soc/infineon/cat1b/Kconfig"
osource "/home/rosy-jwang/zephyrproject/zephyr/soc/infineon/cat1a/Kconfig"
osource "/home/rosy-jwang/zephyrproject/zephyr/soc/gd/gd32/Kconfig"
osource "/home/rosy-jwang/zephyrproject/zephyr/soc/gaisler/leon3/Kconfig"
osource "/home/rosy-jwang/zephyrproject/zephyr/soc/gaisler/gr716a/Kconfig"
osource "/home/rosy-jwang/zephyrproject/zephyr/soc/espressif/Kconfig"
osource "/home/rosy-jwang/zephyrproject/zephyr/soc/ene/kb1200/Kconfig"
osource "/home/rosy-jwang/zephyrproject/zephyr/soc/ene/kb106x/Kconfig"
osource "/home/rosy-jwang/zephyrproject/zephyr/soc/efinix/sapphire/Kconfig"
osource "/home/rosy-jwang/zephyrproject/zephyr/soc/cdns/xtensa_sample_controller/Kconfig"
osource "/home/rosy-jwang/zephyrproject/zephyr/soc/cdns/sample_controller32/Kconfig"
osource "/home/rosy-jwang/zephyrproject/zephyr/soc/cdns/dc233c/Kconfig"
osource "/home/rosy-jwang/zephyrproject/zephyr/soc/brcm/bcmvk/Kconfig"
osource "/home/rosy-jwang/zephyrproject/zephyr/soc/brcm/bcm2712/Kconfig"
osource "/home/rosy-jwang/zephyrproject/zephyr/soc/brcm/bcm2711/Kconfig"
osource "/home/rosy-jwang/zephyrproject/zephyr/soc/bflb/Kconfig"
osource "/home/rosy-jwang/zephyrproject/zephyr/soc/atmel/sam0/Kconfig"
osource "/home/rosy-jwang/zephyrproject/zephyr/soc/atmel/sam/Kconfig"
osource "/home/rosy-jwang/zephyrproject/zephyr/soc/aspeed/Kconfig"
osource "/home/rosy-jwang/zephyrproject/zephyr/soc/arm/Kconfig"
osource "/home/rosy-jwang/zephyrproject/zephyr/soc/arm/beetle/Kconfig"
osource "/home/rosy-jwang/zephyrproject/zephyr/soc/antmicro/myra/Kconfig"
osource "/home/rosy-jwang/zephyrproject/zephyr/soc/andestech/Kconfig"
osource "/home/rosy-jwang/zephyrproject/zephyr/soc/amd/acp_6_0/Kconfig"
osource "/home/rosy-jwang/zephyrproject/zephyr/soc/ambiq/Kconfig"
osource "/home/rosy-jwang/zephyrproject/zephyr/soc/aesc/Kconfig"
osource "/home/rosy-jwang/zephyrproject/zephyr/soc/adi/max32/Kconfig"
```
